/* USER CODE BEGIN Header */
/**
  ******************************************************************************
  * @file    freertos.c
  * @brief   Code for freertos applications
  * @note    Generated by CubeMX (FreeRTOS, CMSIS_V2 interface), then hand-edited
  *          to move the Driving Wheel sensor/button/UART loop into
  *          6 tasks + 5 queues, per the plan worked out with Claude.
  ******************************************************************************
  */
/* USER CODE END Header */

/* Includes ------------------------------------------------------------------*/
#include "FreeRTOS.h"
#include "task.h"
#include "main.h"
#include "cmsis_os.h"

/* Private includes ----------------------------------------------------------*/
/* USER CODE BEGIN Includes */
#include "mpu6050.h"
#include "i2c.h"
#include "usart.h"
#include "tim.h"
#include "string.h"
#include "stdio.h"

/* Sensor packet carried through sensorQueue. Must exist before
 * MX_FREERTOS_Init() uses sizeof(SensorPacket_t) below. */
typedef struct {
    float Ax, Ay, Az;
    float Gx, Gy, Gz;
    float Temp;
} SensorPacket_t;
/* USER CODE END Includes */

/* Private typedef -----------------------------------------------------------*/
/* USER CODE BEGIN PTD */

/* USER CODE END PTD */

/* Private define ------------------------------------------------------------*/
/* USER CODE BEGIN PD */

/* USER CODE END PD */

/* Private macro -------------------------------------------------------------*/
/* USER CODE BEGIN PM */

/* USER CODE END PM */

/* Private variables ---------------------------------------------------------*/
/* USER CODE BEGIN Variables */
static MPU6050_t mpu = {0};   /* only SensorTask touches this */
/* USER CODE END Variables */
/* Definitions for SensorTask */
osThreadId_t SensorTaskHandle;
const osThreadAttr_t SensorTask_attributes = {
  .name = "SensorTask",
  .stack_size = 128 * 4,
  .priority = (osPriority_t) osPriorityAboveNormal,
};
/* Definitions for HeadlightTask */
osThreadId_t HeadlightTaskHandle;
const osThreadAttr_t HeadlightTask_attributes = {
  .name = "HeadlightTask",
  .stack_size = 128 * 4,
  .priority = (osPriority_t) osPriorityLow,
};
/* Definitions for LeftSignalTask */
osThreadId_t LeftSignalTaskHandle;
const osThreadAttr_t LeftSignalTask_attributes = {
  .name = "LeftSignalTask",
  .stack_size = 128 * 4,
  .priority = (osPriority_t) osPriorityLow1,
};
/* Definitions for RightSignalTask */
osThreadId_t RightSignalTaskHandle;
const osThreadAttr_t RightSignalTask_attributes = {
  .name = "RightSignalTask",
  .stack_size = 128 * 4,
  .priority = (osPriority_t) osPriorityLow2,
};
/* Definitions for ResetButtonTask */
osThreadId_t ResetButtonTaskHandle;
const osThreadAttr_t ResetButtonTask_attributes = {
  .name = "ResetButtonTask",
  .stack_size = 128 * 4,
  .priority = (osPriority_t) osPriorityLow3,
};
/* Definitions for UartTask */
osThreadId_t UartTaskHandle;
const osThreadAttr_t UartTask_attributes = {
  .name = "UartTask",
  .stack_size = 256 * 4,
  .priority = (osPriority_t) osPriorityHigh,
};
/* Definitions for sensorQueue */
osMessageQueueId_t sensorQueueHandle;
const osMessageQueueAttr_t sensorQueue_attributes = {
  .name = "sensorQueue"
};
/* Definitions for resetQueue */
osMessageQueueId_t resetQueueHandle;
const osMessageQueueAttr_t resetQueue_attributes = {
  .name = "resetQueue"
};
/* Definitions for leftQueue */
osMessageQueueId_t leftQueueHandle;
const osMessageQueueAttr_t leftQueue_attributes = {
  .name = "leftQueue"
};
/* Definitions for rightQueue */
osMessageQueueId_t rightQueueHandle;
const osMessageQueueAttr_t rightQueue_attributes = {
  .name = "rightQueue"
};
/* Definitions for headlightQueue */
osMessageQueueId_t headlightQueueHandle;
const osMessageQueueAttr_t headlightQueue_attributes = {
  .name = "headlightQueue"
};

/* Private function prototypes -----------------------------------------------*/
/* USER CODE BEGIN FunctionPrototypes */

#define SENSOR_PERIOD_MS  100U   /* sensor + UART line period */

/* 3-sample debounce (same logic the button tasks already used). */
typedef struct { int rawPrev; int stable; int state; } Debounce_t;

static int debounce_update(Debounce_t *d, int raw)
{
  if (raw == d->rawPrev) { if (d->stable < 2) d->stable++; }
  else                   { d->stable = 0; }
  d->rawPrev = raw;
  if (d->stable >= 2) d->state = raw;
  return d->state;
}

/* Empty a queue completely. *any = OR of every value received (so a short
 * tap that rose and fell between two prints is still seen), *last = newest
 * value. Returns how many items were drained. */
static int drain_queue(osMessageQueueId_t q, uint16_t *any, uint16_t *last)
{
  uint16_t v;
  int n = 0;
  *any = 0;
  while (osMessageQueueGet(q, &v, NULL, 0) == osOK) {
    *any |= v;
    *last = v;
    n++;
  }
  return n;
}
/* USER CODE END FunctionPrototypes */

void StartDefaultTask06(void *argument);
void StartTask01(void *argument);
void StartTask02(void *argument);
void StartTask03(void *argument);
void StartTask04(void *argument);
void StartTask05(void *argument);

void MX_FREERTOS_Init(void); /* (MISRA C 2004 rule 8.1) */

/**
  * @brief  FreeRTOS initialization
  * @param  None
  * @retval None
  */
void MX_FREERTOS_Init(void) {
  /* USER CODE BEGIN Init */

  /* USER CODE END Init */

  /* USER CODE BEGIN RTOS_MUTEX */
  /* add mutexes, ... */
  /* USER CODE END RTOS_MUTEX */

  /* USER CODE BEGIN RTOS_SEMAPHORES */
  /* add semaphores, ... */
  /* USER CODE END RTOS_SEMAPHORES */

  /* USER CODE BEGIN RTOS_TIMERS */
  /* start timers, add new ones, ... */
  /* USER CODE END RTOS_TIMERS */

  /* Create the queue(s) */
  /* creation of sensorQueue */
  sensorQueueHandle = osMessageQueueNew (4, sizeof(SensorPacket_t), &sensorQueue_attributes);

  /* creation of resetQueue */
  resetQueueHandle = osMessageQueueNew (8, sizeof(uint16_t), &resetQueue_attributes);

  /* creation of leftQueue */
  leftQueueHandle = osMessageQueueNew (8, sizeof(uint16_t), &leftQueue_attributes);

  /* creation of rightQueue */
  rightQueueHandle = osMessageQueueNew (8, sizeof(uint16_t), &rightQueue_attributes);

  /* creation of headlightQueue */
  headlightQueueHandle = osMessageQueueNew (8, sizeof(uint16_t), &headlightQueue_attributes);

  /* USER CODE BEGIN RTOS_QUEUES */
  /* add queues, ... */
  /* USER CODE END RTOS_QUEUES */

  /* Create the thread(s) */
  /* creation of SensorTask */
  SensorTaskHandle = osThreadNew(StartDefaultTask06, NULL, &SensorTask_attributes);

  /* creation of HeadlightTask */
  HeadlightTaskHandle = osThreadNew(StartTask01, NULL, &HeadlightTask_attributes);

  /* creation of LeftSignalTask */
  LeftSignalTaskHandle = osThreadNew(StartTask02, NULL, &LeftSignalTask_attributes);

  /* creation of RightSignalTask */
  RightSignalTaskHandle = osThreadNew(StartTask03, NULL, &RightSignalTask_attributes);

  /* creation of ResetButtonTask */
  ResetButtonTaskHandle = osThreadNew(StartTask04, NULL, &ResetButtonTask_attributes);

  /* creation of UartTask */
  UartTaskHandle = osThreadNew(StartTask05, NULL, &UartTask_attributes);

  /* USER CODE BEGIN RTOS_THREADS */
  /* UartTask uses a blocking (polling) transmit, so it must be the LOWEST
   * priority task: it then runs in the gaps and never starves the sensor
   * or button tasks. Set here so CubeMX regeneration doesn't undo it. */
  osThreadSetPriority(SensorTaskHandle,     osPriorityAboveNormal);
  osThreadSetPriority(HeadlightTaskHandle,  osPriorityNormal);
  osThreadSetPriority(LeftSignalTaskHandle, osPriorityNormal);
  osThreadSetPriority(RightSignalTaskHandle,osPriorityNormal);
  osThreadSetPriority(ResetButtonTaskHandle,osPriorityNormal);
  osThreadSetPriority(UartTaskHandle,       osPriorityLow);
  /* USER CODE END RTOS_THREADS */

  /* USER CODE BEGIN RTOS_EVENTS */
  /* add events, ... */
  /* USER CODE END RTOS_EVENTS */

}

/* USER CODE BEGIN Header_StartDefaultTask06 */
/**
  * @brief  Function implementing the SensorTask thread.
  *         Reads the MPU6050 on a fixed 100 ms period (osDelayUntil),
  *         using the real elapsed time as dt, and pushes one packet into
  *         sensorQueue for UartTask to pick up.
  * @param  argument: Not used
  * @retval None
  */
/* USER CODE END Header_StartDefaultTask06 */
void StartDefaultTask06(void *argument)
{
  /* USER CODE BEGIN StartDefaultTask06 */
  uint32_t next = osKernelGetTickCount();
  uint32_t last = next;
  for(;;)
  {
    /* Real elapsed time since the previous read, so the complementary
     * filter integrates the gyro over the true dt. */
    uint32_t now = osKernelGetTickCount();
    float dt = (float)(now - last) / 1000.0f;
    last = now;
    if (dt <= 0.0f || dt > 0.5f) dt = SENSOR_PERIOD_MS / 1000.0f;  /* first pass / hiccup */

    MPU6050_Read_All(&hi2c3, &mpu, dt);
    SensorPacket_t packet = {
      .Ax = mpu.Ax, .Ay = mpu.Ay, .Az = mpu.Az,
      .Gx = mpu.Gx, .Gy = mpu.Gy, .Gz = mpu.Gz,
      .Temp = mpu.Temperature
    };
    /* Non-blocking put: drop if UartTask is behind rather than stall. */
    osMessageQueuePut(sensorQueueHandle, &packet, 0, 0);

    /* Fixed period (no drift from the work above). */
    next += SENSOR_PERIOD_MS;
    osDelayUntil(next);
  }
  /* USER CODE END StartDefaultTask06 */
}

/* USER CODE BEGIN Header_StartTask01 */
/**
* @brief Function implementing the HeadlightTask thread.
*        Polls PA6 every 20 ms, debounces, cycles the brightness mode
*        (0 off / 1 half / 2 full), drives TIM1_CH1 PWM directly, and posts
*        (mode << 1 | button level) into headlightQueue for UartTask.
* @param argument: Not used
* @retval None
*/
/* USER CODE END Header_StartTask01 */
void StartTask01(void *argument)
{
  /* USER CODE BEGIN StartTask01 */
  Debounce_t deb = {0, 0, 0};
  int headprev = 0, headtype = 0;
  for(;;)
  {
    int raw = (HAL_GPIO_ReadPin(GPIOA, GPIO_PIN_6) == GPIO_PIN_RESET) ? 1 : 0;
    int buttonhead = debounce_update(&deb, raw);
    if (buttonhead == 1 && headprev == 0) {
      headtype++;
      if (headtype == 3) headtype = 0;
      __HAL_TIM_SET_COMPARE(&htim1, TIM_CHANNEL_1, (headtype * 50));
    }
    headprev = buttonhead;
    /* bit0 = button level, bits1..2 = current brightness mode (0/1/2) */
    uint16_t value = (uint16_t)((headtype << 1) | buttonhead);
    osMessageQueuePut(headlightQueueHandle, &value, 0, 0);
    osDelay(20);
  }
  /* USER CODE END StartTask01 */
}

/* USER CODE BEGIN Header_StartTask02 */
/**
* @brief Function implementing the LeftSignalTask thread.
*        Polls PA4, debounces, pushes the debounced 0/1 state into
*        leftQueue.
* @param argument: Not used
* @retval None
*/
/* USER CODE END Header_StartTask02 */
void StartTask02(void *argument)
{
  /* USER CODE BEGIN StartTask02 */
  int rawPrev = 0, stableCount = 0, state = 0;

  for(;;)
  {
    int raw = (HAL_GPIO_ReadPin(GPIOA, GPIO_PIN_4) == GPIO_PIN_RESET) ? 1 : 0;

    if (raw == rawPrev) {
      if (stableCount < 2) stableCount++;
    } else {
      stableCount = 0;
    }
    rawPrev = raw;

    if (stableCount >= 2) {
      state = raw;
    }

    uint16_t value = (uint16_t)state;
    osMessageQueuePut(leftQueueHandle, &value, 0, 0);

    osDelay(20);
  }
  /* USER CODE END StartTask02 */
}

/* USER CODE BEGIN Header_StartTask03 */
/**
* @brief Function implementing the RightSignalTask thread.
*        Polls PA5, debounces, pushes the debounced 0/1 state into
*        rightQueue.
* @param argument: Not used
* @retval None
*/
/* USER CODE END Header_StartTask03 */
void StartTask03(void *argument)
{
  /* USER CODE BEGIN StartTask03 */
  int rawPrev = 0, stableCount = 0, state = 0;

  for(;;)
  {
    int raw = (HAL_GPIO_ReadPin(GPIOA, GPIO_PIN_5) == GPIO_PIN_RESET) ? 1 : 0;

    if (raw == rawPrev) {
      if (stableCount < 2) stableCount++;
    } else {
      stableCount = 0;
    }
    rawPrev = raw;

    if (stableCount >= 2) {
      state = raw;
    }

    uint16_t value = (uint16_t)state;
    osMessageQueuePut(rightQueueHandle, &value, 0, 0);

    osDelay(20);
  }
  /* USER CODE END StartTask03 */
}

/* USER CODE BEGIN Header_StartTask04 */
/**
* @brief Function implementing the ResetButtonTask thread.
*        Polls PA3, debounces, pushes the debounced 0/1 state into
*        resetQueue.
* @param argument: Not used
* @retval None
*/
/* USER CODE END Header_StartTask04 */
void StartTask04(void *argument)
{
  /* USER CODE BEGIN StartTask04 */
  int buttonRawPrev = 0, buttonStableCount = 0, button = 0;

  for(;;)
  {
    int buttonRaw = (HAL_GPIO_ReadPin(GPIOA, GPIO_PIN_3) == GPIO_PIN_RESET) ? 1 : 0;

    if (buttonRaw == buttonRawPrev) {
      if (buttonStableCount < 2) buttonStableCount++;
    } else {
      buttonStableCount = 0;
    }
    buttonRawPrev = buttonRaw;

    if (buttonStableCount >= 2) {
      button = buttonRaw;
    }

    uint16_t value = (uint16_t)button;
    osMessageQueuePut(resetQueueHandle, &value, 0, 0);

    osDelay(20);
  }
  /* USER CODE END StartTask04 */
}

/* USER CODE BEGIN Header_StartTask05 */
/**
* @brief Function implementing the UartTask thread.
*        Waits on sensorQueue for a new packet, then fully drains each
*        button queue (a button counts as pressed if it was down at ANY
*        sample since the last line), builds the text line the web page
*        expects (plus a trailing Mode field) and sends it over UART.
*        Lowest priority: its polled transmit must never starve the others.
* @param argument: Not used
* @retval None
*/
/* USER CODE END Header_StartTask05 */
void StartTask05(void *argument)
{
  /* USER CODE BEGIN StartTask05 */
  SensorPacket_t packet = {0};
  uint16_t button = 0, buttonleft = 0, buttonright = 0, buttonhead = 0, headmode = 0;
  uint16_t lastReset = 0, lastLeft = 0, lastRight = 0, lastHead = 0, any;
  for(;;)
  {
    /* Paced by SensorTask: one line per new sensor packet. */
    if (osMessageQueueGet(sensorQueueHandle, &packet, NULL, osWaitForever) == osOK)
    {
      /* Each button queue is drained completely. If the button was down at
       * ANY sample since the last line, report 1, so a quick tap is never
       * lost between two prints. No new sample -> keep previous value. */
      if (drain_queue(resetQueueHandle,  &any, &lastReset)) button      = any & 1;
      if (drain_queue(leftQueueHandle,   &any, &lastLeft))  buttonleft  = any & 1;
      if (drain_queue(rightQueueHandle,  &any, &lastRight)) buttonright = any & 1;
      if (drain_queue(headlightQueueHandle, &any, &lastHead)) {
        buttonhead = any & 1;
        headmode   = lastHead >> 1;      /* newest brightness mode */
      }

      char sAx[10], sAy[10], sAz[10], sGx[10], sGy[10], sGz[10], sTemp[10];
      format_float2(sAx, packet.Ax);
      format_float2(sAy, packet.Ay);
      format_float2(sAz, packet.Az);
      format_float2(sGx, packet.Gx);
      format_float2(sGy, packet.Gy);
      format_float2(sGz, packet.Gz);
      format_float2(sTemp, packet.Temp);

      char msg[160];
      int len = snprintf(msg, sizeof(msg),
              "Ax:%s Ay:%s Az:%s Gx:%s Gy:%s Gz:%s Temp:%sC Button:%d Left:%d Right:%d Head:%d Mode:%d\r\n",
              sAx, sAy, sAz, sGx, sGy, sGz, sTemp,
              button, buttonleft, buttonright, buttonhead, headmode);
      if (len > 0) {
        if (len > (int)sizeof(msg) - 1) len = sizeof(msg) - 1;
        HAL_UART_Transmit(&huart2, (uint8_t*)msg, (uint16_t)len, HAL_MAX_DELAY);
      }
    }
  }
  /* USER CODE END StartTask05 */
}

/* Private application code --------------------------------------------------*/
/* USER CODE BEGIN Application */

/* USER CODE END Application */

